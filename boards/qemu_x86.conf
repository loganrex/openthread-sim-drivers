## drivers/entropy/Kconfig
```kconfig
menuconfig FAKE_ENTROPY_QEMU
	bool "Native qemu entropy driver"
	default y
	depends on DT_HAS_SIM_QEMU_RNG_ENABLED
	select ENTROPY_HAS_DRIVER
```

## drivers/ieee802154/Kconfig
```kconfig
# IEEE 802.15.4 driver configuration options

#
# IEEE 802.15.4 options
#
menuconfig IEEE802154
    bool "IEEE 802.15.4 drivers"
    depends on NETWORKING
    default y if NET_L2_PHY_IEEE802154


if IEEE802154
rsource "Kconfig.sim_uart_pipe"
endif # IEEE802154
```

## dts/bindings/ieee802154/sim,ieee802154-uart-pipe.yaml
```yaml
description: UART PIPE fake radio device (used in QEMU)

compatible: "sim,ieee802154-uart-pipe"

include: base.yaml
```
