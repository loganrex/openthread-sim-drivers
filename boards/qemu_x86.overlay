/ {
	chosen {
        zephyr,entropy = &rng;
		zephyr,ieee802154 = &ieee802154;
    };

	rng: rng {
		status = "okay";
		compatible = "sim,qemu-rng";
	};


};

&ieee802154 {
	compatible = "sim,ieee802154-uart-pipe";
	status = "okay";
};